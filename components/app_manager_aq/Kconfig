## components/app_manager_aq/Kconfig
```kconfig
menu "Application Manager"

    config AQ_COMMS_WAIT_MS
        int "Timeout for waiting for IP address (ms)"
        range 1000 30000
        default 8000
        help
            Timeout in milliseconds to wait for the USB network interface to get an IP address.

endmenu
```

## components/usb_comms_aq/Kconfig
```kconfig
menu "USB NCM Configuration"

config LWIP_DHCPS
    bool "Enable DHCP server"
    default y
    help
        Enable DHCP server for USB NCM host auto-IP.

endmenu
```

## components/usb_netif_aq/Kconfig
```kconfig
menu "usb_netif_aq"
    config AQ_USB_USE_ECM_FALLBACK
        bool "Usar ECM como fallback"
        default n
    config AQ_USB_HOSTNAME
        string "Hostname USB"
        default "esp32-usbncm"
    config AQ_USB_LOG_LEVEL
        int "Log level (0-5)"
        range 0 5
        default 3
endmenu
```
